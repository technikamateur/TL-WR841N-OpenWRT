// change flash@0 to the following
flash@0 {
		compatible = "jedec,spi-nor";
		reg = <0>;
		spi-max-frequency = <25000000>;

		partitions {
			compatible = "fixed-partitions";
			#address-cells = <1>;
			#size-cells = <1>;

			uboot: partition@0 {
				label = "u-boot";
				reg = <0x000000 0x020000>;
				read-only;
			};

			partition@20000 {
				compatible = "tplink,firmware";
				label = "firmware";
				reg = <0x020000 0xfd0000>; //for 8M use 0xfa0000 instead of 0xfd0000
			};

			art: partition@ff0000 {       //for 8M use fc0000 instead of ff0000
				label = "art";
				reg = <0xff0000 0x010000>; //for 8M use 0xfc0000 instead of 0xff0000
				read-only;
			};
		};
